AUTOSAR XML (schema 00046)
package /CS_interface_lab
  client server interface cs_if_sum
    operation OP_sum
      arg var1: type=uint32, direction=IN
      arg var2: type=uint32, direction=IN
      arg var3: type=uint32, direction=OUT
  application sw component type swc1_server
    provide port PP_CS_sum: client-server-annotation=OP_sum
  application sw component type swc2_client
    require port RP_CS_sum: client-server-annotation=OP_sum
