AUTOSAR XML (schema 00046)
package /INTERFACE_LAB
  sender receiver interface SR_lidar
    data object_distance: type=uint32, init-value=7
  sensor actuator sw component type lidar_SWC
    provide port PPlidar: provided-interface=SR_lidar
  application sw component type lidar_algo_SWC
    provide port RPlidar: provided-interface=SR_lidar
