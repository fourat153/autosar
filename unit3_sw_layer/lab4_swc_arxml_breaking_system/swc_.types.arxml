AUTOSAR XML (schema 00046)
package /SWCs_EABS_Package
  sensor actuator sw component type Lidar_SWC1
  sensor actuator sw component type SpeedSwnsor_SWC2
  ecu abstraction sw component type IOabs_SWC3
  application sw component type EABS_SWC4
  parameter sw component type P_d_SWC5
  sensor actuator sw component type LED_Warning_SWC6
  complex device driver sw component type Brea_CDD_SWC7
  service sw component type DIgMang_service_SWC8
  nv block sw component type flash_NV_block_SWC9
